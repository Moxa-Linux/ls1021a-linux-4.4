## Documentation/devicetree/bindings/rtc/intersil,isl1208.txt
```
Intersil ISL1208, ISL1218 I2C RTC/Alarm chip

ISL1208 is a trivial I2C device (it has simple device tree bindings,
consisting of a compatible field, an address and possibly an interrupt
line).

Required properties supported by the device:

 - "compatible": must be one of
	"isil,isl1208"
	"isil,isl1218"
 - "reg": I2C bus address of the device

Optional properties:

 - "interrupt-parent", "interrupts", "interrupts-extended":
   for passing the interrupt line of the SoC connected to #IRQ pin
   of the RTC chip.


Example isl1208 node without #IRQ pin connected:

	isl1208: isl1208@68 {
		compatible = "isil,isl1208";
		reg = <0x68>;
	};

Example isl1208 node with #IRQ pin connected to SoC gpio1 pin 12:

	isl1208: isl1208@68 {
		compatible = "isil,isl1208";
		reg = <0x68>;
		interrupt-parent = <&gpio1>;
		interrupts = <12 IRQ_TYPE_EDGE_FALLING>;
	};
```

## drivers/char/moxa_uc8410a_dio/Kconfig
```kconfig
#
#  MOXA Digital I/O driver
#

menu "MOXA UC-8410A DIO driver"

config UC8410A_DIO
	tristate "UC-8410A DIO"
        ---help---

	  MOXA UC-8410A Digital I/O driver

endmenu
```

## its/ls102xa-moxa-uc-8420.its
```
/*
 * U-Boot itb image source file for "uc8420 project"
 */

/dts-v1/;

/ {
	description = "U-Boot itb image source file for uc8420 project";
	#address-cells = <1>;
	
	images {
		kernel@uc8420_zImage {
			description = "Moxa UC8420 Series Unify Linux Kernel";
			data = /incbin/("../arch/arm/boot/zImage");
			type = "kernel";
			arch = "arm";
			os = "linux";
			compression = "none";
			load = <0x80080000>;
			entry = <0x80080000>;
		};
		fdt@uc8420 {
			description = "Flattened Device Tree blob for UC8420";
			data = /incbin/("../arch/arm/boot/dts/ls102xa-moxa-uc-8420.dtb");
			type = "flat_dt";
			arch = "arm";
			compression = "none";
			load = <0x80000000>;
		};
		fdt@uc8422 {
			description = "Flattened Device Tree blob for UC8422";
			data = /incbin/("../arch/arm/boot/dts/ls102xa-moxa-uc-8422.dtb");
			type = "flat_dt";
			arch = "arm";
			compression = "none";
			load = <0x80000000>;
		};
	};
	
	configurations {
		default = "uc8422";
		uc8420 {
			description = "Boot Linux kernel with uc8420 FDT blob";
			kernel = "kernel@uc8420_zImage";
			fdt = "fdt@uc8420";
		};
		uc8422 {
			description = "Boot Linux kernel with uc8422 FDT blob";
			kernel = "kernel@uc8420_zImage";
			fdt = "fdt@uc8422";
		};
	};
};
```
